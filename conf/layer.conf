## conf/layer.conf
```bitbake
# We have a conf and classes directory, append to BBPATH
BBPATH .= ":${LAYERDIR}"

# We have a recipes directory, add to BBFILES
BBFILES += " \
    ${LAYERDIR}/recipes-*/*/*.bb \
    ${LAYERDIR}/recipes-*/*/*.bbappend \
"

BBFILE_COLLECTIONS += "meta-openxt-externalsrc"
BBFILE_PATTERN_meta-openxt-externalsrc := "^${LAYERDIR}/"
BBFILE_PRIORITY_meta-openxt-externalsrc = "9"

LAYERVERSION_meta-openxt-externalsrc = "1"
LAYERSERIES_COMPAT_meta-openxt-externalsrc = "dunfell"

LAYERDEPENDS_meta-openxt-externalsrc = " \
    core \
    xenclient-oe \
"
```
